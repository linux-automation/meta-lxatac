## meta-lxatac-bsp/conf/layer.conf
```bitbake
# We have a conf and classes directory, add to BBPATH
BBPATH .= ":${LAYERDIR}"

# We have recipes-* directories, add to BBFILES
BBFILES += "${LAYERDIR}/recipes-*/*/*.bb \
            ${LAYERDIR}/recipes-*/*/*.bbappend"

# this name must correspond with the following two variable names
BBFILE_COLLECTIONS += "lxatac-bsp"
BBFILE_PATTERN_lxatac-bsp = "^${LAYERDIR}/"
BBFILE_PRIORITY_lxatac-bsp = "11"

LAYERDEPENDS_lxatac-bsp = "core ptx rauc lxatac-software"
LAYERSERIES_COMPAT_lxatac-bsp = "styhead"

RAUC_KEY_FILE ?= "${LAYERDIR}/recipes-core/rauc/files/devel.key.pem"
RAUC_CERT_FILE ?= "${LAYERDIR}/recipes-core/rauc/files/devel.cert.pem"
RAUC_KEYRING_FILE ?= "${LAYERDIR}/recipes-core/rauc/files/devel.cert.pem"
RAUC_CERT_ENABLE ?= "stable.cert.pem"
```

## meta-lxatac-software/conf/layer.conf
```bitbake
# We have a conf and classes directory, add to BBPATH
BBPATH .= ":${LAYERDIR}"

# We have recipes-* directories, add to BBFILES
BBFILES += "${LAYERDIR}/recipes-*/*/*.bb \
            ${LAYERDIR}/recipes-*/*/*.bbappend"

# this name must correspond with the following two variable names
BBFILE_COLLECTIONS += "lxatac-software"
BBFILE_PATTERN_lxatac-software = "^${LAYERDIR}/"
BBFILE_PRIORITY_lxatac-software = "7"

LAYERDEPENDS_lxatac-software = "core openembedded-layer networking-layer ptx rauc"
LAYERSERIES_COMPAT_lxatac-software = "styhead"
```
